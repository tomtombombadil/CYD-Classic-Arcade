// Intel 8080 CPU interpreter - see i8080.h.
//
// Dispatch: one switch over the opcode; the regular blocks (MOV 40-7F, the
// ALU 80-BF) are generated by macros. F is kept as the chip stores it, so
// PUSH PSW needs no packing.
#include "i8080.h"

namespace i8080 {

static_assert(__BYTE_ORDER__ == __ORDER_LITTLE_ENDIAN__, "Pair assumes little-endian");

namespace {

// S, Z, even parity and the always-set bit 1 of a byte result.
struct FlagTable {
    uint8_t szp[256];
    constexpr FlagTable() : szp()
    {
        for (int v = 0; v < 256; ++v) {
            int p = 0;
            for (int b = 0; b < 8; ++b) p ^= (v >> b) & 1;
            szp[v] = uint8_t((v & SF) | (v == 0 ? ZF : 0) | (p ? 0 : PF) | F1);
        }
    }
};
constexpr FlagTable kFlags{};
#define SZP(v) kFlags.szp[uint8_t(v)]

// States per opcode; conditional calls / returns list the not-taken time
// (taken adds 6). Conditional jumps take 10 either way.
constexpr uint8_t kCycles[256] = {
     4,10, 7, 5, 5, 5, 7, 4,  4,10, 7, 5, 5, 5, 7, 4,   // 00
     4,10, 7, 5, 5, 5, 7, 4,  4,10, 7, 5, 5, 5, 7, 4,   // 10
     4,10,16, 5, 5, 5, 7, 4,  4,10,16, 5, 5, 5, 7, 4,   // 20
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     5,10,10, 4,11,11, 7,11,  5, 5,10, 4,11,17, 7,11,   // F0
};

uint8_t default_read(void*, uint16_t) { return 0xff; }
void default_write(void*, uint16_t, uint8_t) {}

} // namespace

#define rA af.b.h
#define rF af.b.l
#define rB bc.b.h
#define rC bc.b.l
#define rD de.b.h
#define rE de.b.l
#define rH hl.b.h
#define rL hl.b.l

Cpu::Cpu()
{
    for (int p = 0; p < kPages; ++p) {
        read_page[p] = nullptr;
        write_page[p] = nullptr;
    }
    mem_read = default_read;
    mem_write = default_write;
    port_in = default_read;
    port_out = default_write;
    reset();
}

void Cpu::map_read(uint16_t start, uint32_t len, const uint8_t* p)
{
    for (uint32_t off = 0; off < len; off += kPageSize)
        read_page[((start + off) >> kPageShift) & (kPages - 1)] = p ? p + off : nullptr;
}

void Cpu::map_write(uint16_t start, uint32_t len, uint8_t* p)
{
    for (uint32_t off = 0; off < len; off += kPageSize)
        write_page[((start + off) >> kPageShift) & (kPages - 1)] = p ? p + off : nullptr;
}

// The 8080 clears only PC and INTE on reset; the rest is what it was. We
// start from fixed values so runs repeat exactly.
void Cpu::reset()
{
    pc.w = 0;
    sp.w = 0;
    af.w = F1;
    bc.w = de.w = hl.w = 0;
    inte = 0;
    halted = false;
    irq_line_ = false;
    ei_delay_ = false;
}

// --- ALU -------------------------------------------------------------------

inline void Cpu::add8(uint8_t v, uint8_t carry)
{
    const unsigned res = unsigned(rA) + v + carry;
    rF = uint8_t(SZP(res) | ((res >> 8) & CF) | ((rA ^ v ^ res) & AC));
    rA = uint8_t(res);
}

// The 8080 subtracts by adding the complement: AC is the carry out of bit 3
// of that add (so 0 - 0 sets it), CY the inverted carry out (the borrow).
inline void Cpu::sub8(uint8_t v, uint8_t borrow)
{
    const unsigned res = unsigned(rA) - v - borrow;
    rF = uint8_t(SZP(res) | ((res >> 8) & CF) | (~(rA ^ v ^ res) & AC));
    rA = uint8_t(res);
}

inline void Cpu::cmp8(uint8_t v)
{
    const unsigned res = unsigned(rA) - v;
    rF = uint8_t(SZP(res) | ((res >> 8) & CF) | (~(rA ^ v ^ res) & AC));
}

// ANA: AC = bit 3 of (A | operand), CY cleared. XRA / ORA clear both.
inline void Cpu::ana8(uint8_t v)
{
    const uint8_t ac = uint8_t(((rA | v) & 0x08) << 1);
    rA &= v;
    rF = uint8_t(SZP(rA) | ac);
}
inline void Cpu::xra8(uint8_t v) { rA ^= v; rF = SZP(rA); }
inline void Cpu::ora8(uint8_t v) { rA |= v; rF = SZP(rA); }

// INR / DCR keep CY; DCR adds FF, so AC = a carry out of bit 3 = the low
// nibble wasn't 0.
inline uint8_t Cpu::inr8(uint8_t v)
{
    const uint8_t res = uint8_t(v + 1);
    rF = uint8_t((rF & CF) | SZP(res) | ((res & 0x0f) ? 0 : AC));
    return res;
}

inline uint8_t Cpu::dcr8(uint8_t v)
{
    const uint8_t res = uint8_t(v - 1);
    rF = uint8_t((rF & CF) | SZP(res) | ((res & 0x0f) == 0x0f ? 0 : AC));
    return res;
}

// DAA: add 06 when the low digit is over 9 or AC; add 60 when the high
// digit (after the low correction) is over 9 or CY. CY is only ever set.
inline void Cpu::daa()
{
    uint8_t add = 0, cy = rF & CF;
    const uint8_t lo = rA & 0x0f, hi = rA >> 4;
    if ((rF & AC) || lo > 9) add = 0x06;
    if (cy || hi > 9 || (hi == 9 && lo > 9)) { add |= 0x60; cy = CF; }
    const unsigned res = unsigned(rA) + add;
    rF = uint8_t(SZP(res) | ((rA ^ add ^ res) & AC) | cy);
    rA = uint8_t(res);
}

// --- interrupts and the run loop -------------------------------------------

int Cpu::take_irq()
{
    halted = false;
    inte = 0;
    if (irq_ack) irq_ack(ctx);
    // The bus instruction: RST n (anything else is taken as RST 7).
    const uint8_t op = (irq_opcode_ & 0xc7) == 0xc7 ? irq_opcode_ : 0xff;
    push(pc.w);
    pc.w = uint16_t(op & 0x38);
    return 11;
}

EMU_HOT int Cpu::run(int cycles)
{
    done_ = 0;
    target_ = cycles;
    while (done_ < target_) {
        if (irq_line_ && inte && !ei_delay_) {
            done_ += take_irq();
            continue;
        }
        ei_delay_ = false;
        if (halted) {
            // Waits for an interrupt: burn the rest of the slice.
            const int n = (target_ - done_ + 3) >> 2;
            done_ += n * 4;
            break;
        }
        done_ += exec(fetch());
    }
    return done_;
}

// --- opcodes ---------------------------------------------------------------

// Register order in opcodes: B C D E H L M A (M = memory at HL).
#define R_0 rB
#define R_1 rC
#define R_2 rD
#define R_3 rE
#define R_4 rH
#define R_5 rL
#define R_7 rA

#define MOV(d, s) case 0x40 + (d) * 8 + (s): R_##d = R_##s; return t;
#define MOV_ROW(d) MOV(d, 0) MOV(d, 1) MOV(d, 2) MOV(d, 3) MOV(d, 4) MOV(d, 5) MOV(d, 7) \
    case 0x46 + (d) * 8: R_##d = rd(hl.w); return t;                                  \
    case 0x70 + (d): wr(hl.w, R_##d); return t;

#define ALU(k, expr_of_v)                                                   \
    case 0x80 + (k) * 8 + 0: { const uint8_t v = rB; expr_of_v; return t; } \
    case 0x80 + (k) * 8 + 1: { const uint8_t v = rC; expr_of_v; return t; } \
    case 0x80 + (k) * 8 + 2: { const uint8_t v = rD; expr_of_v; return t; } \
    case 0x80 + (k) * 8 + 3: { const uint8_t v = rE; expr_of_v; return t; } \
    case 0x80 + (k) * 8 + 4: { const uint8_t v = rH; expr_of_v; return t; } \
    case 0x80 + (k) * 8 + 5: { const uint8_t v = rL; expr_of_v; return t; } \
    case 0x80 + (k) * 8 + 6: { const uint8_t v = rd(hl.w); expr_of_v; return t; } \
    case 0x80 + (k) * 8 + 7: { const uint8_t v = rA; expr_of_v; return t; }

#define JMP_IF(cond) { const uint16_t a = fetch16(); if (cond) pc.w = a; return t; }
#define CALL_IF(cond) { const uint16_t a = fetch16(); if (cond) { push(pc.w); pc.w = a; t += 6; } return t; }
#define RET_IF(cond) { if (cond) { pc.w = pop(); t += 6; } return t; }
#define RST(n) push(pc.w); pc.w = (n); return t;

EMU_HOT int Cpu::exec(uint8_t op)
{
    int t = kCycles[op];
    switch (op) {
    case 0x00: case 0x08: case 0x10: case 0x18:
    case 0x20: case 0x28: case 0x30: case 0x38:
        return t;                                   // NOP (and its undocumented copies)
    case 0x01: bc.w = fetch16(); return t;
    case 0x11: de.w = fetch16(); return t;
    case 0x21: hl.w = fetch16(); return t;
    case 0x31: sp.w = fetch16(); return t;
    case 0x02: wr(bc.w, rA); return t;              // STAX
    case 0x12: wr(de.w, rA); return t;
    case 0x0a: rA = rd(bc.w); return t;             // LDAX
    case 0x1a: rA = rd(de.w); return t;
    case 0x22: wr16(fetch16(), hl.w); return t;     // SHLD
    case 0x2a: hl.w = rd16(fetch16()); return t;    // LHLD
    case 0x32: wr(fetch16(), rA); return t;         // STA
    case 0x3a: rA = rd(fetch16()); return t;        // LDA
    case 0x03: ++bc.w; return t;
    case 0x13: ++de.w; return t;
    case 0x23: ++hl.w; return t;
    case 0x33: ++sp.w; return t;
    case 0x0b: --bc.w; return t;
    case 0x1b: --de.w; return t;
    case 0x2b: --hl.w; return t;
    case 0x3b: --sp.w; return t;
    case 0x09: case 0x19: case 0x29: case 0x39: {   // DAD: only CY
        const uint16_t v = op == 0x09 ? bc.w : op == 0x19 ? de.w : op == 0x29 ? hl.w : sp.w;
        const uint32_t res = uint32_t(hl.w) + v;
        rF = uint8_t((rF & ~CF) | (res >> 16));
        hl.w = uint16_t(res);
        return t;
    }
    case 0x04: rB = inr8(rB); return t;
    case 0x0c: rC = inr8(rC); return t;
    case 0x14: rD = inr8(rD); return t;
    case 0x1c: rE = inr8(rE); return t;
    case 0x24: rH = inr8(rH); return t;
    case 0x2c: rL = inr8(rL); return t;
    case 0x34: wr(hl.w, inr8(rd(hl.w))); return t;
    case 0x3c: rA = inr8(rA); return t;
    case 0x05: rB = dcr8(rB); return t;
    case 0x0d: rC = dcr8(rC); return t;
    case 0x15: rD = dcr8(rD); return t;
    case 0x1d: rE = dcr8(rE); return t;
    case 0x25: rH = dcr8(rH); return t;
    case 0x2d: rL = dcr8(rL); return t;
    case 0x35: wr(hl.w, dcr8(rd(hl.w))); return t;
    case 0x3d: rA = dcr8(rA); return t;
    case 0x06: rB = fetch(); return t;              // MVI
    case 0x0e: rC = fetch(); return t;
    case 0x16: rD = fetch(); return t;
    case 0x1e: rE = fetch(); return t;
    case 0x26: rH = fetch(); return t;
    case 0x2e: rL = fetch(); return t;
    case 0x36: wr(hl.w, fetch()); return t;
    case 0x3e: rA = fetch(); return t;
    case 0x07: { // RLC
        const uint8_t c = rA >> 7;
        rA = uint8_t((rA << 1) | c);
        rF = uint8_t((rF & ~CF) | c);
        return t;
    }
    case 0x0f: { // RRC
        const uint8_t c = rA & 1;
        rA = uint8_t((rA >> 1) | (c << 7));
        rF = uint8_t((rF & ~CF) | c);
        return t;
    }
    case 0x17: { // RAL
        const uint8_t c = rA >> 7;
        rA = uint8_t((rA << 1) | (rF & CF));
        rF = uint8_t((rF & ~CF) | c);
        return t;
    }
    case 0x1f: { // RAR
        const uint8_t c = rA & 1;
        rA = uint8_t((rA >> 1) | ((rF & CF) << 7));
        rF = uint8_t((rF & ~CF) | c);
        return t;
    }
    case 0x27: daa(); return t;
    case 0x2f: rA = uint8_t(~rA); return t;         // CMA: no flags
    case 0x37: rF |= CF; return t;                  // STC
    case 0x3f: rF ^= CF; return t;                  // CMC

    MOV_ROW(0) MOV_ROW(1) MOV_ROW(2) MOV_ROW(3) MOV_ROW(4) MOV_ROW(5) MOV_ROW(7)
    case 0x76: halted = true; return t;             // HLT

    ALU(0, add8(v, 0)) ALU(1, add8(v, rF & CF)) ALU(2, sub8(v, 0)) ALU(3, sub8(v, rF & CF))
    ALU(4, ana8(v))    ALU(5, xra8(v))          ALU(6, ora8(v))    ALU(7, cmp8(v))

    case 0xc0: RET_IF(!(rF & ZF))
    case 0xc8: RET_IF(rF & ZF)
    case 0xd0: RET_IF(!(rF & CF))
    case 0xd8: RET_IF(rF & CF)
    case 0xe0: RET_IF(!(rF & PF))
    case 0xe8: RET_IF(rF & PF)
    case 0xf0: RET_IF(!(rF & SF))
    case 0xf8: RET_IF(rF & SF)
    case 0xc9: case 0xd9: pc.w = pop(); return t;   // RET (D9 undocumented)

    case 0xc2: JMP_IF(!(rF & ZF))
    case 0xca: JMP_IF(rF & ZF)
    case 0xd2: JMP_IF(!(rF & CF))
    case 0xda: JMP_IF(rF & CF)
    case 0xe2: JMP_IF(!(rF & PF))
    case 0xea: JMP_IF(rF & PF)
    case 0xf2: JMP_IF(!(rF & SF))
    case 0xfa: JMP_IF(rF & SF)
    case 0xc3: case 0xcb: pc.w = fetch16(); return t;   // JMP (CB undocumented)

    case 0xc4: CALL_IF(!(rF & ZF))
    case 0xcc: CALL_IF(rF & ZF)
    case 0xd4: CALL_IF(!(rF & CF))
    case 0xdc: CALL_IF(rF & CF)
    case 0xe4: CALL_IF(!(rF & PF))
    case 0xec: CALL_IF(rF & PF)
    case 0xf4: CALL_IF(!(rF & SF))
    case 0xfc: CALL_IF(rF & SF)
    case 0xcd: case 0xdd: case 0xed: case 0xfd: {   // CALL (DD ED FD undocumented)
        const uint16_t a = fetch16();
        push(pc.w);
        pc.w = a;
        return t;
    }

    case 0xc1: bc.w = pop(); return t;
    case 0xd1: de.w = pop(); return t;
    case 0xe1: hl.w = pop(); return t;
    case 0xf1: af.w = uint16_t((pop() & 0xffd7) | F1); return t;   // POP PSW
    case 0xc5: push(bc.w); return t;
    case 0xd5: push(de.w); return t;
    case 0xe5: push(hl.w); return t;
    case 0xf5: push(af.w); return t;

    case 0xc6: add8(fetch(), 0); return t;          // ADI
    case 0xce: add8(fetch(), rF & CF); return t;    // ACI
    case 0xd6: sub8(fetch(), 0); return t;          // SUI
    case 0xde: sub8(fetch(), rF & CF); return t;    // SBI
    case 0xe6: ana8(fetch()); return t;             // ANI
    case 0xee: xra8(fetch()); return t;             // XRI
    case 0xf6: ora8(fetch()); return t;             // ORI
    case 0xfe: cmp8(fetch()); return t;             // CPI

    case 0xc7: RST(0x00)
    case 0xcf: RST(0x08)
    case 0xd7: RST(0x10)
    case 0xdf: RST(0x18)
    case 0xe7: RST(0x20)
    case 0xef: RST(0x28)
    case 0xf7: RST(0x30)
    case 0xff: RST(0x38)

    case 0xd3: { const uint8_t n = fetch(); port_out(ctx, uint16_t(n | (n << 8)), rA); return t; }
    case 0xdb: { const uint8_t n = fetch(); rA = port_in(ctx, uint16_t(n | (n << 8))); return t; }
    case 0xe3: { const uint16_t v = rd16(sp.w); wr16(sp.w, hl.w); hl.w = v; return t; }   // XTHL
    case 0xe9: pc.w = hl.w; return t;               // PCHL
    case 0xeb: { const uint16_t v = de.w; de.w = hl.w; hl.w = v; return t; }   // XCHG
    case 0xf9: sp.w = hl.w; return t;               // SPHL
    case 0xf3: inte = 0; return t;                  // DI
    case 0xfb: inte = 1; ei_delay_ = true; return t;   // EI
    default:   return t;                            // not reached: every opcode is listed
    }
}

} // namespace i8080
